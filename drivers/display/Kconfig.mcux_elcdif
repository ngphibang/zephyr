## drivers/display/Kconfig.mcux_elcdif
```kconfig
# Copyright 2019,2023-2024 NXP
# Copyright (c) 2022, Basalte bv
# SPDX-License-Identifier: Apache-2.0


menuconfig DISPLAY_MCUX_ELCDIF
	bool "MCUX eLCDIF driver"
	default y
	depends on DT_HAS_NXP_IMX_ELCDIF_ENABLED
	select PINCTRL
	help
	  Enable support for mcux eLCDIF driver.

if DISPLAY_MCUX_ELCDIF

config MCUX_ELCDIF_FB_NUM
	int "Framebuffers to allocate in driver"
	default 2
	range 0 2
	help
	  Number of framebuffers to allocate in ELCDIF driver. Driver allocated
	  framebuffers are required to support partial display updates.
	  The driver has been validated to support 0 through 2 framebuffers.
	  A write covering the whole panel is scanned out of the caller's
	  buffer whatever the count, and that buffer stays in use until the
	  next full-frame write returns (SCREEN_INFO_WRITE_HOLDS_BUFFER).
	  The driver framebuffers serve partial updates and the frame shown
	  before the first write.

config MCUX_ELCDIF_FB_SIZE
	int "Framebuffer size required by the eLCDIF driver"
	default 3686400
	help
	  eLCDIF driver allocates framebuffers to support partial display updates.
	  The framebuffer size is computed as : panel_width * panel_height * bpp.
	  The default value is set to afford for a default resolution of 1280x720 and
	  4-bytes pixel format, e.g. ARGB8888. Applications should change this value
	  according to the actual used resolution and format to optimize the heap size.

config MCUX_ELCDIF_START_ON_INIT
	bool "Start the ELCDIF display driver during initialization"
	depends on MCUX_ELCDIF_FB_NUM != 0
	default y
	help
	  Start scanning the first driver framebuffer at initialization instead
	  of at the first display_write(). Panel controllers that need the pixel
	  stream before they accept commands, such as MIPI DSI panels in video
	  mode, require it; without a driver framebuffer there is nothing to
	  scan, so MCUX_ELCDIF_FB_NUM must be at least 1 for them.

endif # DISPLAY_MCUX_ELCDIF
```

## subsys/mpipe/ai/Kconfig
```kconfig
#
# Copyright 2026 NXP
#
# SPDX-License-Identifier: Apache-2.0
#

config MPIPE_AI
	bool "AI/ML plugin support"
	help
	  Enable the AI/ML plugin: elements that convert media buffers to
	  tensors, run neural network inference through a pluggable backend
	  and decode the resulting tensors into application-level results.

if MPIPE_AI

config MPIPE_AI_MAX_IO_TENSORS
	int "Maximum input/output tensors of a model"
	range 1 16
	default 4
	help
	  Size of the per-direction tensor descriptor set. Four covers the
	  common detection post-processing convention (boxes, classes,
	  scores, count).

config MPIPE_AI_CONVERT
	bool "Video frame to tensor converter element"
	help
	  Element converting a video frame into a model input tensor in one
	  pass: nearest-neighbor scaling, color conversion and quantization.

if MPIPE_AI_CONVERT

config MPIPE_AI_CONVERT_POOL_NUM
	int "Number of tensor buffers of the converter"
	range 1 8
	default 2

config MPIPE_AI_CONVERT_MAX_TENSOR_SIZE
	int "Maximum output tensor size of the converter (in bytes)"
	default 16384
	help
	  Upper bound of one converted tensor; sizes the static buffer pool.
	  9216 covers a 96x96 single-channel model input.

endif # MPIPE_AI_CONVERT

config MPIPE_AI_INFER
	bool "Neural network inference element"
	help
	  Element running a model on every input tensor buffer through the
	  selected backend.

if MPIPE_AI_INFER

choice MPIPE_AI_BACKEND
	prompt "Inference backend"
	default MPIPE_AI_BACKEND_FAKE

config MPIPE_AI_BACKEND_FAKE
	bool "Fake backend"
	help
	  Deterministic pseudo-inference with no runtime dependency, for
	  framework bring-up and continuous integration.

endchoice

config MPIPE_AI_INFER_POOL_NUM
	int "Number of output buffers of the inference element"
	range 1 8
	default 2

config MPIPE_AI_INFER_MAX_OUT_SIZE
	int "Maximum total output size of a model (in bytes)"
	default 512
	help
	  Upper bound of the flat buffer holding every output tensor of one
	  inference; sizes the static buffer pool. Classification outputs
	  are tiny; detection outputs need a few kilobytes.

endif # MPIPE_AI_INFER

config MPIPE_AI_DECODE
	bool "Tensor decode element"
	help
	  Transform element turning output tensors into a results stream:
	  ranked class scores or score-filtered bounding boxes, one
	  results structure per buffer, typically consumed by an app_sink.

config MPIPE_AI_DECODE_POOL_NUM
	int "Number of results buffers of the decode element"
	range 1 8
	default 2
	depends on MPIPE_AI_DECODE

config MPIPE_AI_RESULTS_MAX
	int "Maximum entries in a result set"
	range 1 32
	default 8

endif # MPIPE_AI
```
