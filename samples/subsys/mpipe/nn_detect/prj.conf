## Kconfig
```
# Copyright 2026 NXP
#
# SPDX-License-Identifier: Apache-2.0

mainmenu "Live detection pipeline sample"

menu "Live detection pipeline configuration"

config VIDEO_SOURCE_CROP_LEFT
	int "Crop area left value"
	default 0

config VIDEO_SOURCE_CROP_TOP
	int "Crop area top value"
	default 0

config VIDEO_SOURCE_CROP_WIDTH
	int "Crop area width value"
	default 0
	help
	  If set to 0, the crop is not applied.

config VIDEO_SOURCE_CROP_HEIGHT
	int "Crop area height value"
	default 0
	help
	  If set to 0, the crop is not applied.

config VIDEO_FRAME_HEIGHT
	int "Height of the video frame"
	default 0
	help
	  If set to 0, the default height is used.

config VIDEO_FRAME_WIDTH
	int "Width of the video frame"
	default 0
	help
	  If set to 0, the default width is used.

config VIDEO_PIXEL_FORMAT
	string "Pixel format of the video frame"
	help
	  If not set, the default pixel format is used.

config VIDEO_CTRL_HFLIP
	int "Mirror the video frame horizontally"
	range 0 1
	default 0

config VIDEO_CTRL_VFLIP
	int "Mirror the video frame vertically"
	range 0 1
	default 0

config VIDEO_ROTATION_ANGLE
	int "Rotate the video frame by a specified angle"
	range 0 270
	default 0
	help
	  Specify one of {0, 90, 180, 270} degrees.

config PROP_NUM_BUFS
	int "Number of buffers the source provides before stopping"
	default 0
	help
	  If not set or set to 0, the source will run forever.

config SAMPLE_OVERLAY_PLANE
	bool "Draw the boxes on a display plane"
	depends on VIDEO_FRAME_WIDTH != 0 && VIDEO_FRAME_HEIGHT != 0
	help
	  Show the camera frame on plane 0 of the display untouched and draw
	  each result set into a transparent frame of the panel's size on
	  plane 1, which the display controller blends over the video at
	  scan-out. Needs a display driver with planes, such as the
	  SDL display or the LCDIFv2; otherwise the overlay draws the latest
	  boxes into every frame before it is displayed.

config SAMPLE_NN_ARENA_SIZE
	int "Tensor arena size in bytes"
	default 320000
	help
	  Working memory handed to the inference backend, which logs how much
	  a model uses at load. The 128x128 Ultraface model needs 310 KB on
	  the CPU, the 320x240 one 1.3 MB, or 1.2 MB on the Neutron NPU.

config SAMPLE_NN_NPU_REGION_NAME
	string "Memory region for the model and its arena on an NPU"
	default "SRAM1"
	depends on TFLM_NXP_NEUTRON
	help
	  Name of a zephyr,memory-region devicetree node the Neutron NPU can
	  reach: the model is copied there at start-up and the arena placed
	  there, both being read by the NPU in place.

config SAMPLE_NN_SCORE_THRESHOLD
	int "Detection score threshold in percent"
	range 1 100
	default 50
	help
	  Boxes scoring below this are not reported. Lower it to see what a
	  model produces on a scene it is unsure about.

config SAMPLE_NN_INPUT_SHIFT
	bool "Shift the input samples by the model's zero point"
	default y
	help
	  Store each input sample as (pixel + SAMPLE_NN_INPUT_ZERO_POINT),
	  the input zero point of a model quantized from pixels scaled to
	  -1..1, the Ultraface models among them. Disabled, the converter
	  stores the raw pixel bytes.

config SAMPLE_NN_INPUT_ZERO_POINT
	int "Zero point added to each input sample"
	depends on SAMPLE_NN_INPUT_SHIFT
	default -128

endmenu

source "Kconfig.zephyr"
```

## prj.conf
```kconfig
CONFIG_LOG=y

CONFIG_MPIPE=y
CONFIG_MPIPE_BASE=y
CONFIG_MPIPE_BASE_CAPS_FILTER=y
CONFIG_MPIPE_BASE_QUEUE=y
CONFIG_MPIPE_BASE_TEE=y
CONFIG_MPIPE_BASE_APP_SINK=y
CONFIG_MPIPE_VID=y
CONFIG_MPIPE_VID_OVERLAY=y
CONFIG_MPIPE_DISP=y
CONFIG_MPIPE_PLAYER=y
CONFIG_MPIPE_NN=y
CONFIG_MPIPE_NN_CONVERTER=y
CONFIG_MPIPE_NN_RUNNER=y
CONFIG_MPIPE_NN_DECODER=y
# The pipeline thread, the display queue, the frame queue and the tensor queue
CONFIG_MPIPE_THREADS_NUM=4
# One tensor being written, one waiting in the tensor queue, one in the runner
CONFIG_MPIPE_NN_CONVERTER_POOL_NUM=3
# Thirteen elements with a hardware video transform
CONFIG_MPIPE_BIN_MAX_CHILDREN=16
# The camera pool and the overlay pool both wrap driver buffers in net_bufs
# drawn from the shared header pool; on a plane the overlay's own frames
# (one shown, one being drawn) come on top
CONFIG_MPIPE_NET_BUF_POOL_COUNT=10

# The bus carries end-of-stream and errors, never data: it needs neither
# zbus priority boost nor zbus logging of its own.
CONFIG_ZBUS_PRIORITY_BOOST=n
CONFIG_ZBUS_LOG_LEVEL_ERR=y
```

## boards/mimxrt1170_evk_mimxrt1176_cm7.conf
```kconfig
# The camera's own queue, the frames held in the two queues, the overlay's copy,
# the PXP's output and the frame kept on screen, slack: 640x480 BGRX32 frames
CONFIG_VIDEO_BUFFER_POOL_NUM_MAX=10
CONFIG_VIDEO_BUFFER_POOL_HEAP_SIZE=12582912
CONFIG_VIDEO_ROTATION_ANGLE=270
# The 4:3 frame the face detectors were trained on
CONFIG_VIDEO_FRAME_WIDTH=640
CONFIG_VIDEO_FRAME_HEIGHT=480

# Optimized int8 kernels for the Cortex-M7
CONFIG_TENSORFLOW_LITE_MICRO_CMSIS_NN_KERNELS=y

# Thirteen elements negotiate on the player worker
CONFIG_MPIPE_PLAYER_WORKER_STACK_SIZE=8192
CONFIG_MPIPE_THREAD_STACK_SIZE=8192

# The LCDIFv2 composes planes: the boxes go on one of their own
CONFIG_SAMPLE_OVERLAY_PLANE=y

# The planes scan the pipeline's buffers out: no driver framebuffer
CONFIG_MCUX_LCDIFV2_FB_NUM=0
```

## boards/native_sim_native_64.conf
```kconfig
CONFIG_VIDEO_FRAME_WIDTH=320
CONFIG_VIDEO_FRAME_HEIGHT=240
CONFIG_PROP_NUM_BUFS=10

# The generator's one, two held in queue_d, one kept on screen, the overlay's copy, slack
CONFIG_VIDEO_BUFFER_POOL_NUM_MAX=8

# The shell reads the p/s/r/q commands from the launching terminal
CONFIG_UART_NATIVE_PTY_0_ON_STDINOUT=y

# Log to stdout from boot, and not a second time through the shell backend
CONFIG_LOG_BACKEND_NATIVE_POSIX=y
CONFIG_SHELL_LOG_BACKEND=n

# Threads on native_sim run on host stacks, so this size only reserves memory
CONFIG_MPIPE_PLAYER_WORKER_STACK_SIZE=64

# The SDL display composes planes: the boxes go on one of their own
CONFIG_SAMPLE_OVERLAY_PLANE=y
```

## src/main.c
```c
/*
 * Copyright 2026 NXP
 *
 * SPDX-License-Identifier: Apache-2.0
 */

/*
 * Live detection with overlay: the camera stream is shown with the detected
 * boxes drawn on top, while the detector runs on a second branch.
 *
 *   vid_src -> caps_filter -> tee -> queue_d -> vid_overlay -> [vid_trans] -> disp_sink
 *                                -> queue_nn -> nn_converter -> queue_tensor
 *                                     -> nn_runner -> nn_decoder -> app_sink
 *
 * The app_sink callback publishes each result set into a latest-results store
 * and the overlay draw callback renders it, one or two frames late.
 */

#include <string.h>

#include <zephyr/drivers/video.h>
#include <zephyr/linker/section_tags.h>
#include <zephyr/video/controls.h>
#include <zephyr/logging/log.h>
#include <zephyr/mpipe/mpipe.h>
#include <zephyr/mpipe/base/mpipe_app_sink.h>
#include <zephyr/mpipe/base/mpipe_caps_filter.h>
#include <zephyr/mpipe/base/mpipe_queue.h>
#include <zephyr/mpipe/base/mpipe_tee.h>
#include <zephyr/mpipe/disp/mpipe_disp_sink.h>
#include <zephyr/mpipe/vid/mpipe_vid_src.h>
#include <zephyr/mpipe/utils/mpipe_player.h>
#include <zephyr/mpipe/nn/mpipe_nn_converter.h>
#include <zephyr/mpipe/nn/mpipe_nn_decoder.h>
#include <zephyr/mpipe/nn/mpipe_nn_runner.h>
#include <zephyr/mpipe/vid/mpipe_vid_draw.h>
#include <zephyr/mpipe/vid/mpipe_vid_overlay.h>
#if DT_HAS_CHOSEN(zephyr_videotrans)
#include <zephyr/mpipe/vid/mpipe_vid_transform.h>
#endif
#if !defined(CONFIG_MPIPE_NN_BACKEND_TFLM)
#include <zephyr/mpipe/nn/mpipe_nn_backend_fake.h>
#endif
#include <zephyr/sys/util_macro.h>

LOG_MODULE_REGISTER(main, CONFIG_LOG_DEFAULT_LEVEL);

/* Element IDs (values are arbitrary; only uniqueness within the pipeline matters) */
enum {
	PIPE_ID,
	VID_SRC_ID,
	CAPS_FILTER_ID,
	TEE_ID,
	QUEUE_D_ID,
	OVERLAY_ID,
	VID_TRANS_ID,
	DISP_SINK_ID,
	QUEUE_NN_ID,
	NN_CONVERTER_ID,
	QUEUE_TENSOR_ID,
	NN_RUNNER_ID,
	NN_DECODER_ID,
	APP_SINK_ID,
};

static struct mpipe pipe;
static struct mpipe_vid_src vid_src;
static struct mpipe_caps_filter caps_filter;
static struct mpipe_tee tee;
static struct mpipe_queue queue_d;
static struct mpipe_queue queue_nn;
static struct mpipe_queue queue_tensor;
static struct mpipe_vid_overlay overlay;
#if DT_HAS_CHOSEN(zephyr_videotrans)
static struct mpipe_vid_transform vid_trans;
#endif
static struct mpipe_disp_sink disp_sink;
static struct mpipe_nn_converter nn_converter;
static struct mpipe_nn_runner nn_runner;
static struct mpipe_nn_decoder nn_decoder;
static struct mpipe_app_sink app_sink;
static struct mpipe_player player;

/* The overlay in the display branch reads what the app_sink publishes here */
static struct mpipe_nn_results_store results_store;

#if defined(CONFIG_MPIPE_NN_BACKEND_TFLM)

static const uint8_t model_data[] __aligned(16) = {
#include "nn_model.inc"
};

#if defined(CONFIG_TFLM_NXP_NEUTRON)
/* The NPU reads the model and the arena in place: both live in a region it reaches */
#define NPU_SECTION Z_GENERIC_SECTION(CONFIG_SAMPLE_NN_NPU_REGION_NAME)
static uint8_t npu_model[sizeof(model_data)] __aligned(16) NPU_SECTION;
static uint8_t arena[CONFIG_SAMPLE_NN_ARENA_SIZE] __aligned(16) NPU_SECTION;
#else
static uint8_t arena[CONFIG_SAMPLE_NN_ARENA_SIZE] __aligned(16);
#endif

#else /* fake backend */

static const struct mpipe_nn_fake_model fake_model_cfg = {
	.in_w = 96,
	.in_h = 96,
	.channels = 1,
	.type = MPIPE_NN_TENSOR_TYPE_INT8,
	.num_classes = 0,
	.num_boxes = 2,
};

static uint8_t arena[64];

#endif /* CONFIG_MPIPE_NN_BACKEND_TFLM */

/* Runs in the display branch thread: render the latest boxes into the frame */
static void draw_cb(uint8_t *frame, uint16_t width, uint16_t height, uint32_t pixfmt,
		    const struct net_buf *in, void *user_data)
{
	struct mpipe_nn_results res;

	ARG_UNUSED(in);
	ARG_UNUSED(user_data);

	if (mpipe_nn_results_store_get(&results_store, &res) != 0 ||
	    res.type != MPIPE_NN_RESULTS_DETECTION) {
		return;
	}

	for (uint8_t i = 0; i < res.count; i++) {
		const struct mpipe_nn_box *box = &res.boxes[i];
		struct mpipe_vid_rect rect = {
			.x0 = (int32_t)(box->xmin * (float)width),
			.y0 = (int32_t)(box->ymin * (float)height),
			.x1 = (int32_t)(box->xmax * (float)width),
			.y1 = (int32_t)(box->ymax * (float)height),
		};

		(void)mpipe_vid_draw_rect(frame, width, height, pixfmt, &rect, 0x0000FF00, 2);
	}
}

/* Runs in the inference branch thread: publish the boxes for the overlay */
static void results_cb(const struct net_buf *buf, void *user_data)
{
	const struct mpipe_nn_results *res =
		(const struct mpipe_nn_results *)(const void *)buf->data;

	ARG_UNUSED(user_data);

	if (mpipe_buffer_get_meta(buf)->bytes_used < sizeof(*res)) {
		return;
	}

	mpipe_nn_results_store_put(&results_store, res);

	if (res->count > 0U) {
		LOG_INF("Frame %u: %u box(es), best score %d%% (class %u)", res->seq, res->count,
			(int)(res->boxes[0].score * 100.0f), res->boxes[0].class_id);
	} else if ((res->seq % 64U) == 0U) {
		/* A heartbeat while nothing is detected */
		LOG_INF("Frame %u: no box", res->seq);
	}
}

int main(void)
{
	static const struct mpipe_app_sink_cb cb = {.fn = results_cb, .user_data = NULL};
#if defined(CONFIG_TFLM_NXP_NEUTRON)
	static const struct mpipe_nn_model model = {.data = npu_model, .size = sizeof(npu_model)};
#elif defined(CONFIG_MPIPE_NN_BACKEND_TFLM)
	static const struct mpipe_nn_model model = {.data = model_data, .size = sizeof(model_data)};
#else
	static const struct mpipe_nn_model model = {.data = (const uint8_t *)&fake_model_cfg,
						    .size = sizeof(fake_model_cfg)};
#endif
	static const struct mpipe_nn_arena arena_desc = {.data = arena, .size = sizeof(arena)};
	static const uint8_t nn_queue_size = 1;
	static const enum mpipe_base_queue_leak nn_queue_leak = MPIPE_BASE_QUEUE_LEAK_OLDEST;
	static const uint8_t display_queue_size = 1;
	static const int frame_queue_priority = CONFIG_MPIPE_THREAD_DEFAULT_PRIORITY - 1;
	static const int nn_thread_priority = K_LOWEST_APPLICATION_THREAD_PRIO;
	static const float threshold = (float)CONFIG_SAMPLE_NN_SCORE_THRESHOLD / 100.0f;
	static const uint8_t decode_type = MPIPE_NN_RESULTS_DETECTION;
	static const struct mpipe_vid_overlay_cb draw = {.fn = draw_cb, .user_data = NULL};
	int ret;

#if defined(CONFIG_TFLM_NXP_NEUTRON)
	memcpy(npu_model, model_data, sizeof(npu_model));
#endif

	mpipe_nn_results_store_init(&results_store);

	ret = mpipe_pipeline_init(&pipe, PIPE_ID);
	if (ret < 0) {
		goto err;
	}
	ret = mpipe_vid_src_init(&vid_src, VID_SRC_ID);
	if (ret < 0) {
		goto err;
	}
	ret = mpipe_caps_filter_init(&caps_filter, CAPS_FILTER_ID);
	if (ret < 0) {
		goto err;
	}
	ret = mpipe_tee_init(&tee, TEE_ID);
	if (ret < 0) {
		goto err;
	}
	ret = mpipe_queue_init(&queue_d, QUEUE_D_ID);
	if (ret < 0) {
		goto err;
	}
	ret = mpipe_queue_init(&queue_nn, QUEUE_NN_ID);
	if (ret < 0) {
		goto err;
	}

	ret = mpipe_queue_init(&queue_tensor, QUEUE_TENSOR_ID);
	if (ret < 0) {
		goto err;
	}
	ret = mpipe_vid_overlay_init(&overlay, OVERLAY_ID);
	if (ret < 0) {
		goto err;
	}
	ret = mpipe_disp_sink_init(&disp_sink, DISP_SINK_ID);
	if (ret < 0) {
		goto err;
	}
	ret = mpipe_nn_converter_init(&nn_converter, NN_CONVERTER_ID);
	if (ret < 0) {
		goto err;
	}
	ret = mpipe_nn_runner_init(&nn_runner, NN_RUNNER_ID);
	if (ret < 0) {
		goto err;
	}
	ret = mpipe_nn_decoder_init(&nn_decoder, NN_DECODER_ID);
	if (ret < 0) {
		goto err;
	}
	ret = mpipe_app_sink_init(&app_sink, APP_SINK_ID);
	if (ret < 0) {
		goto err;
	}

	struct video_rect __maybe_unused crop = {
		CONFIG_VIDEO_SOURCE_CROP_LEFT, CONFIG_VIDEO_SOURCE_CROP_TOP,
		CONFIG_VIDEO_SOURCE_CROP_WIDTH, CONFIG_VIDEO_SOURCE_CROP_HEIGHT};

	/* clang-format off */
	ret = mpipe_object_set_properties((struct mpipe_object *)&vid_src,
		COND_CODE_0(CONFIG_PROP_NUM_BUFS, (),
			    (MPIPE_PROP_SRC_NUM_BUFS, CONFIG_PROP_NUM_BUFS,))
		COND_CODE_0(CONFIG_VIDEO_SOURCE_CROP_WIDTH, (), (MPIPE_PROP_VID_CROP, &crop,))
		IF_ENABLED(CONFIG_VIDEO_CTRL_HFLIP, (VIDEO_CID_HFLIP, CONFIG_VIDEO_CTRL_HFLIP,))
		IF_ENABLED(CONFIG_VIDEO_CTRL_VFLIP, (VIDEO_CID_VFLIP, CONFIG_VIDEO_CTRL_VFLIP,))
		MPIPE_PROP_LIST_END);
	/* clang-format on */
	if (ret < 0) {
		goto err;
	}

	/* clang-format off */
	struct mpipe_structure caps;
	struct mpipe_value pixfmt;

	ret = mpipe_structure_init_fields(&caps, MPIPE_MEDIA_VIDEO,
		COND_CODE_0(CONFIG_VIDEO_FRAME_WIDTH,
			(), (MPIPE_CAPS_IMAGE_WIDTH, MPIPE_TYPE_UINT, CONFIG_VIDEO_FRAME_WIDTH,))
		COND_CODE_0(CONFIG_VIDEO_FRAME_HEIGHT,
			(), (MPIPE_CAPS_IMAGE_HEIGHT, MPIPE_TYPE_UINT, CONFIG_VIDEO_FRAME_HEIGHT,))
		MPIPE_CAPS_END);
	/* clang-format on */
	if (ret != 0) {
		goto err;
	}

	if (strcmp(CONFIG_VIDEO_PIXEL_FORMAT, "") != 0) {
		ret = mpipe_value_set(&pixfmt, MPIPE_TYPE_UINT,
				      VIDEO_FOURCC_FROM_STR(CONFIG_VIDEO_PIXEL_FORMAT));
		if (ret < 0) {
			goto err;
		}

		ret = mpipe_structure_append_value(&caps, MPIPE_CAPS_PIXEL_FORMAT, &pixfmt);
		if (ret < 0) {
			goto err;
		}
	}

	ret = mpipe_object_set_properties((struct mpipe_object *)&caps_filter,
					  MPIPE_PROP_BASE_CAPS_FILTER_CAPS, &caps,
					  MPIPE_PROP_LIST_END);
	if (ret < 0) {
		goto err;
	}

	/*
	 * Two single-slot queues dropping the oldest: the converter runs one priority
	 * above the streaming threads so it releases the shared frame before the overlay
	 * draws in it, the runner at the lowest priority so a slow model starves nothing
	 */
	ret = mpipe_object_set_properties(
		(struct mpipe_object *)&queue_nn, MPIPE_PROP_BASE_QUEUE_SIZE, &nn_queue_size,
		MPIPE_PROP_BASE_QUEUE_LEAK, &nn_queue_leak, MPIPE_PROP_BASE_QUEUE_THREAD_PRIORITY,
		&frame_queue_priority, MPIPE_PROP_LIST_END);
	if (ret < 0) {
		goto err;
	}

	ret = mpipe_object_set_properties(
		(struct mpipe_object *)&queue_tensor, MPIPE_PROP_BASE_QUEUE_SIZE, &nn_queue_size,
		MPIPE_PROP_BASE_QUEUE_LEAK, &nn_queue_leak, MPIPE_PROP_BASE_QUEUE_THREAD_PRIORITY,
		&nn_thread_priority, MPIPE_PROP_LIST_END);
	if (ret < 0) {
		goto err;
	}

	/* The display branch queue: one slot, so the camera pool stays within the CSI's four */
	ret = mpipe_object_set_properties((struct mpipe_object *)&queue_d,
					  MPIPE_PROP_BASE_QUEUE_SIZE, &display_queue_size,
					  MPIPE_PROP_LIST_END);
	if (ret < 0) {
		goto err;
	}

#ifdef CONFIG_SAMPLE_NN_INPUT_SHIFT
	static const int32_t zero_point = CONFIG_SAMPLE_NN_INPUT_ZERO_POINT;

	ret = mpipe_object_set_properties((struct mpipe_object *)&nn_converter,
					  MPIPE_PROP_NN_CONVERTER_ZERO_POINT, &zero_point,
					  MPIPE_PROP_LIST_END);
	if (ret < 0) {
		goto err;
	}
#endif

	ret = mpipe_object_set_properties((struct mpipe_object *)&nn_runner, MPIPE_PROP_NN_MODEL,
					  &model, MPIPE_PROP_NN_ARENA, &arena_desc,
					  MPIPE_PROP_LIST_END);
	if (ret < 0) {
		goto err;
	}

	ret = mpipe_object_set_properties(
		(struct mpipe_object *)&nn_decoder, MPIPE_PROP_NN_DECODER_TYPE, &decode_type,
		MPIPE_PROP_NN_DECODER_THRESHOLD, &threshold, MPIPE_PROP_LIST_END);
	if (ret < 0) {
		goto err;
	}

	ret = mpipe_object_set_properties((struct mpipe_object *)&overlay,
					  MPIPE_PROP_VID_OVERLAY_DRAW_CB, &draw,
					  MPIPE_PROP_LIST_END);
	if (ret < 0) {
		goto err;
	}

	ret = mpipe_object_set_properties((struct mpipe_object *)&app_sink,
					  MPIPE_PROP_BASE_APP_SINK_CB, &cb, MPIPE_PROP_LIST_END);
	if (ret < 0) {
		goto err;
	}

#if DT_HAS_CHOSEN(zephyr_videotrans)
	ret = mpipe_vid_transform_init(&vid_trans, VID_TRANS_ID);
	if (ret < 0) {
		goto err;
	}

	/* clang-format off */
	ret = mpipe_object_set_properties((struct mpipe_object *)&vid_trans,
		COND_CODE_0(CONFIG_VIDEO_ROTATION_ANGLE,
			(), (VIDEO_CID_ROTATE, CONFIG_VIDEO_ROTATION_ANGLE,)) MPIPE_PROP_LIST_END);
	/* clang-format on */
	if (ret < 0) {
		goto err;
	}
#endif

	/* clang-format off */
	/* Add elements to the pipeline - order does not matter */
	ret = mpipe_bin_add((struct mpipe_bin *)&pipe,
			(struct mpipe_element *)&vid_src,
			(struct mpipe_element *)&caps_filter,
			(struct mpipe_element *)&tee,
			(struct mpipe_element *)&queue_d,
			(struct mpipe_element *)&overlay,
			IF_ENABLED(DT_HAS_CHOSEN(zephyr_videotrans),
				   ((struct mpipe_element *)&vid_trans,))
			(struct mpipe_element *)&disp_sink,
			(struct mpipe_element *)&queue_nn,
			(struct mpipe_element *)&nn_converter,
			(struct mpipe_element *)&queue_tensor,
			(struct mpipe_element *)&nn_runner,
			(struct mpipe_element *)&nn_decoder,
			(struct mpipe_element *)&app_sink, NULL);
	if (ret < 0) {
		LOG_ERR("Failed to add elements (%d)", ret);
		goto err;
	}

	/* Branch 1: camera to display, boxes drawn before the transform */
	ret = mpipe_element_link((struct mpipe_element *)&vid_src,
			(struct mpipe_element *)&caps_filter,
			(struct mpipe_element *)&tee,
			(struct mpipe_element *)&queue_d,
			(struct mpipe_element *)&overlay,
			IF_ENABLED(DT_HAS_CHOSEN(zephyr_videotrans),
				   ((struct mpipe_element *)&vid_trans,))
			(struct mpipe_element *)&disp_sink, NULL);
	if (ret < 0) {
		LOG_ERR("Failed to link branch 1 (%d)", ret);
		goto err;
	}

	/* Branch 2: tee (2nd src pad) to the detector */
	ret = mpipe_element_link((struct mpipe_element *)&tee,
			(struct mpipe_element *)&queue_nn,
			(struct mpipe_element *)&nn_converter,
			(struct mpipe_element *)&queue_tensor,
			(struct mpipe_element *)&nn_runner,
			(struct mpipe_element *)&nn_decoder,
			(struct mpipe_element *)&app_sink, NULL);
	if (ret < 0) {
		LOG_ERR("Failed to link branch 2 (%d)", ret);
		goto err;
	}
	/* clang-format on */

	LOG_INF("Pipeline linked.");

	ret = mpipe_player_init(&player, &pipe);
	if (ret != 0) {
		LOG_ERR("Failed to init player (%d)", ret);
		goto err;
	}

	(void)mpipe_player_play(&player);
	(void)mpipe_player_wait_quit(&player);
	(void)mpipe_player_deinit(&player);

	LOG_INF("Done.");

	return 0;

err:
	LOG_ERR("Aborting sample");
	return 0;
}
```
