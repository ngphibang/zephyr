## subsys/mpipe/erpc/Kconfig
```kconfig
#
# Copyright 2026 NXP
#
# SPDX-License-Identifier: Apache-2.0
#

config MPIPE_ERPC
	bool "eRPC backend for the client elements"
	depends on MPIPE_RPC
	depends on ZEPHYR_ERPC_MODULE
	help
	  Carry the RPC hooks of the client elements over eRPC, with the
	  Zephyr IPC service as the transport.

	  This brings up the eRPC clients, one per endpoint, and reports their
	  errors; each plugin binds each of its eRPC interfaces to a client of
	  its own. The interface definitions are compiled at build time by the
	  erpcgen host tool.

	  The library and its transport are the module's own options, ERPC
	  and ERPC_TRANSPORT_IPC_SERVICE: the application enables both.

if MPIPE_ERPC

config MPIPE_ERPC_INIT_DELAY_MS
	int "Delay before the first exchange with the remote core (in milliseconds)"
	default 300
	help
	  Time the client transport waits before it talks to the remote core,
	  which may still be booting when the pipeline is built.

endif # MPIPE_ERPC
```

## subsys/mpipe/vid/Kconfig
```kconfig
#
# Copyright 2025 NXP
#
# SPDX-License-Identifier: Apache-2.0
#

config MPIPE_VID
	bool "Video plugin support"
	select VIDEO
	help
	  Elements backed by Zephyr video devices: capture from a camera, and
	  memory-to-memory transforms performed by hardware such as a scaler,
	  rotator or decoder.

	  This is where zero-copy matters most, so the pools here hand out the
	  driver's own buffers rather than copies, and a frame captured by a
	  camera reaches the display without being moved.

if MPIPE_VID

config MPIPE_VID_CONVERT
	bool "Software-based pixel format converter"
	help
	  A transform that converts a frame from one pixel format to another on
	  the CPU.

	  It exists as the fallback for a conversion no hardware on the board can
	  do, which is common between a decoder's output format and what a panel
	  accepts. It converts pixel formats only: it does not scale, crop or
	  rotate. Expect it to cost real CPU time per frame.

config MPIPE_VID_OVERLAY
	bool "Video overlay element"
	help
	  A transform handing every buffer to an application draw callback,
	  the pipeline equivalent of drawing on a canvas, with drawing helpers
	  for rectangles, fills and text. In frame mode it draws into the video
	  frame, in place when nobody else holds it and into a copy otherwise,
	  as behind a tee. In plane mode it draws into a transparent BGRA32
	  frame of its own for a display sink on a display plane, and the
	  display controller blends the drawing over the video. Text needs the
	  character framebuffer's built-in fonts
	  (CHARACTER_FRAMEBUFFER_USE_DEFAULT_FONTS).

	  It is the software fallback and demonstration tier: the target for
	  compositing is an aggregator-based compositor and, where the display
	  controller has them, hardware layers.

config MPIPE_VID_PIPELINE_SERVER
	bool "Video adapter of the pipeline server"
	depends on MPIPE_PIPELINE_SERVER
	help
	  Serve a video pipeline to a video client element on another core:
	  the functions answering the calls of the video transform and sink
	  clients with a pipeline server, translating between the formats of
	  the video API the clients speak and the capabilities the served
	  pipeline negotiates with.

config MPIPE_VID_PIPELINE_SERVER_ERPC
	bool "eRPC binding of the video pipeline server"
	depends on MPIPE_VID_PIPELINE_SERVER
	depends on ZEPHYR_ERPC_MODULE
	help
	  Receive the calls of the video client elements of another core over
	  eRPC, with the Zephyr IPC service as the transport, and answer them
	  with a pipeline server. The server side of the interfaces the eRPC
	  backend of the client elements (MPIPE_ERPC) speaks.

	  The library and its transport are the module's own options, ERPC
	  and ERPC_TRANSPORT_IPC_SERVICE: the application enables both.

if MPIPE_ERPC || MPIPE_VID_PIPELINE_SERVER_ERPC

config MPIPE_VID_ERPC_TRANSFORM_ENDPOINT
	string "Endpoint of the video transform interface"
	default "mpipe_vid_transform"
	help
	  Name of the IPC service endpoint the video transform client and its
	  server meet on. Both cores must use the same name.

config MPIPE_VID_ERPC_SINK_ENDPOINT
	string "Endpoint of the video sink interface"
	default "mpipe_vid_sink"
	help
	  Name of the IPC service endpoint the video sink client and its
	  server meet on. Both cores must use the same name.

endif # MPIPE_ERPC || MPIPE_VID_PIPELINE_SERVER_ERPC

endif # MPIPE_VID
```
