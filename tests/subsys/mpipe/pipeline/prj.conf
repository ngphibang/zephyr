## prj.conf
```kconfig
CONFIG_ZTEST=y
CONFIG_MPIPE=y
CONFIG_MPIPE_FAKE_SRC=y
CONFIG_ZBUS_MSG_SUBSCRIBER=y
CONFIG_MPIPE_BASE=y
CONFIG_MPIPE_BASE_APP_SRC=y
CONFIG_MPIPE_BASE_APP_SRC_BUF_SZ=256
CONFIG_MPIPE_BASE_APP_SINK=y
CONFIG_MPIPE_AI=y
CONFIG_MPIPE_AI_CONVERT=y
CONFIG_MPIPE_AI_INFER=y
CONFIG_MPIPE_AI_DECODE=y
```

## src/test_ai_pipeline.c
```c
/*
 * Copyright 2026 NXP
 *
 * SPDX-License-Identifier: Apache-2.0
 */

#include <zephyr/drivers/video.h>
#include <zephyr/ztest.h>
#include <zephyr/zbus/zbus.h>

#include <zephyr/mpipe/mpipe.h>
#include <zephyr/mpipe/base/mpipe_app_sink.h>
#include <zephyr/mpipe/base/mpipe_app_src.h>
#include <zephyr/mpipe/ai/mpipe_ai_backend_fake.h>
#include <zephyr/mpipe/ai/mpipe_ai_convert.h>
#include <zephyr/mpipe/ai/mpipe_ai_decode.h>
#include <zephyr/mpipe/ai/mpipe_ai_infer.h>

ZBUS_MSG_SUBSCRIBER_DEFINE(test_ai_pipeline_sub);

/* Element IDs (values are arbitrary; only uniqueness within the pipeline matters) */
enum {
	PIPE_ID,
	SRC_ID,
	CONVERT_ID,
	INFER_ID,
	DECODE_ID,
	SINK_ID,
};

/* Number of images the application pushes before EOS */
#define TEST_BUFS_NUM 10

/* The fake model: a 16x16 single-channel int8 classifier with 4 classes */
#define TEST_DIM         16
#define TEST_NUM_CLASSES 4

static const struct mpipe_ai_fake_model fake_model_cfg = {
	.in_w = TEST_DIM,
	.in_h = TEST_DIM,
	.channels = 1,
	.dtype = MPIPE_AI_TENSOR_TYPE_INT8,
	.num_classes = TEST_NUM_CLASSES,
};

static uint8_t test_image[TEST_DIM * TEST_DIM];
static uint8_t test_arena[64];

static struct {
	atomic_t count;
	struct mpipe_ai_results last;
} cb_state;

/* Runs in the pipeline thread: copy the results snapshot out */
static void test_results_cb(const struct net_buf *buf, void *user_data)
{
	ARG_UNUSED(user_data);

	if (mpipe_buffer_get_meta(buf)->bytes_used >= sizeof(struct mpipe_ai_results)) {
		cb_state.last = *(const struct mpipe_ai_results *)(const void *)buf->data;
		atomic_inc(&cb_state.count);
	}
}

struct test_ai_pipeline_fixture {
	struct mpipe pipeline;
	struct mpipe_app_src app_src;
	struct mpipe_ai_convert convert;
	struct mpipe_ai_infer infer;
	struct mpipe_ai_decode decode;
	struct mpipe_app_sink app_sink;
};

static void *ai_pipeline_suite_setup(void)
{
	static struct test_ai_pipeline_fixture fixture;

	/* A known image: the fake inference derives the winning class from it */
	for (size_t i = 0; i < sizeof(test_image); i++) {
		test_image[i] = (uint8_t)i;
	}

	return &fixture;
}

static void ai_pipeline_before(void *f)
{
	struct test_ai_pipeline_fixture *fix = f;
	static const struct mpipe_ai_model model = {
		.data = (const uint8_t *)&fake_model_cfg,
		.size = sizeof(fake_model_cfg),
	};
	static const struct mpipe_ai_arena arena = {
		.data = test_arena,
		.size = sizeof(test_arena),
	};
	static const struct mpipe_app_sink_cb cb = {
		.fn = test_results_cb,
		.user_data = NULL,
	};
	struct mpipe_structure caps;

	memset(fix, 0, sizeof(*fix));
	atomic_set(&cb_state.count, 0);
	memset(&cb_state.last, 0, sizeof(cb_state.last));

	zassert_ok(mpipe_pipeline_init(&fix->pipeline, PIPE_ID));
	zassert_ok(mpipe_app_src_init(&fix->app_src, SRC_ID));
	zassert_ok(mpipe_ai_convert_init(&fix->convert, CONVERT_ID));
	zassert_ok(mpipe_ai_infer_init(&fix->infer, INFER_ID));
	zassert_ok(mpipe_ai_decode_init(&fix->decode, DECODE_ID));
	zassert_ok(mpipe_app_sink_init(&fix->app_sink, SINK_ID));

	/* The application pushes grey 16x16 frames */
	zassert_ok(mpipe_structure_init_fields(
			   &caps, MPIPE_MEDIA_VIDEO, MPIPE_CAPS_PIXEL_FORMAT, MPIPE_TYPE_UINT,
			   VIDEO_PIX_FMT_GREY, MPIPE_CAPS_IMAGE_WIDTH, MPIPE_TYPE_UINT, TEST_DIM,
			   MPIPE_CAPS_IMAGE_HEIGHT, MPIPE_TYPE_UINT, TEST_DIM, MPIPE_CAPS_END),
		   "Failed to init app_src caps");
	zassert_ok(mpipe_object_set_properties((struct mpipe_object *)&fix->app_src,
					       MPIPE_PROP_BASE_APP_SRC_CAPS, &caps,
					       MPIPE_PROP_LIST_END),
		   "Failed to set app_src caps");

	zassert_ok(mpipe_object_set_properties((struct mpipe_object *)&fix->infer,
					       MPIPE_PROP_AI_MODEL, &model, MPIPE_PROP_AI_ARENA,
					       &arena, MPIPE_PROP_LIST_END),
		   "Failed to set infer properties");

	zassert_ok(mpipe_object_set_properties((struct mpipe_object *)&fix->app_sink,
					       MPIPE_PROP_BASE_APP_SINK_CB, &cb,
					       MPIPE_PROP_LIST_END),
		   "Failed to set app_sink callback");
}

static void ai_pipeline_after(void *f)
{
	struct test_ai_pipeline_fixture *fix = f;
	struct zbus_channel *bus =
		mpipe_element_get_bus_chan((struct mpipe_element *)&fix->pipeline);

	/* Also runs when the test failed before detaching its own observer. */
	(void)zbus_chan_rm_obs(bus, &test_ai_pipeline_sub, K_FOREVER);
}

ZTEST_SUITE(test_ai_pipeline, NULL, ai_pipeline_suite_setup, ai_pipeline_before, ai_pipeline_after,
	    NULL);

/*
 * app_src(grey 16x16 image) -> ai_convert -> ai_infer(fake backend) ->
 * ai_decode -> app_sink. Negotiation must settle on the model's input tensor,
 * every pushed image must produce one deterministic classification result at
 * the app_sink, and EOS must reach the bus, on every run of a replay.
 */
ZTEST_F(test_ai_pipeline, test_pipeline_ai_classification)
{
	const struct zbus_channel *chan;
	struct zbus_channel *bus;
	struct mpipe_message msg;
	uint32_t sum = 0;
	uint16_t expected_class;

	/*
	 * The converter stores each pixel as its raw byte (the int8 tensor
	 * reinterprets it). The fake backend crowns class (sum of tensor
	 * bytes) mod num_classes.
	 */
	for (size_t i = 0; i < sizeof(test_image); i++) {
		sum += test_image[i];
	}
	expected_class = (uint16_t)(sum % TEST_NUM_CLASSES);

	zassert_ok(mpipe_bin_add((struct mpipe_bin *)&fixture->pipeline,
				 (struct mpipe_element *)&fixture->app_src,
				 (struct mpipe_element *)&fixture->convert,
				 (struct mpipe_element *)&fixture->infer,
				 (struct mpipe_element *)&fixture->decode,
				 (struct mpipe_element *)&fixture->app_sink, NULL),
		   "Failed to add elements");

	zassert_ok(mpipe_element_link((struct mpipe_element *)&fixture->app_src,
				      (struct mpipe_element *)&fixture->convert,
				      (struct mpipe_element *)&fixture->infer,
				      (struct mpipe_element *)&fixture->decode,
				      (struct mpipe_element *)&fixture->app_sink, NULL),
		   "Failed to link elements");

	bus = mpipe_element_get_bus_chan((struct mpipe_element *)&fixture->pipeline);
	zassert_ok(zbus_chan_add_obs(bus, &test_ai_pipeline_sub, K_FOREVER),
		   "Failed to add observer to pipeline channel");

	/* A replay is where state left behind by the previous run shows up */
	for (int run = 0; run < 3; run++) {
		atomic_set(&cb_state.count, 0);

		zassert_ok(mpipe_element_set_state((struct mpipe_element *)&fixture->pipeline,
						   MPIPE_STATE_PLAYING),
			   "run %d failed to start PLAYING", run);

		/* Stream the image from the application, then declare end of stream */
		for (int i = 0; i < TEST_BUFS_NUM; i++) {
			zassert_ok(mpipe_app_src_push(&fixture->app_src, test_image,
						      sizeof(test_image), K_SECONDS(1)),
				   "run %d failed to push image %d", run, i);
		}
		zassert_ok(mpipe_app_src_eos(&fixture->app_src, K_SECONDS(1)),
			   "run %d failed to push EOS", run);

		/* Wait for EOS posted by the app_sink */
		zassert_ok(zbus_sub_wait_msg(&test_ai_pipeline_sub, &chan, &msg, K_FOREVER),
			   "run %d timed out waiting for a pipeline message", run);
		zassert_equal(msg.type, MPIPE_MESSAGE_EOS, "run %d: expected EOS, got %d", run,
			      msg.type);

		/* Exactly one EOS per run: a second would mean the aggregation leaked */
		zassert_equal(zbus_sub_wait_msg(&test_ai_pipeline_sub, &chan, &msg, K_MSEC(50)),
			      -ENOMSG, "run %d produced more than one message", run);

		/* Every image produced one result, in order, numbered from one */
		zassert_equal(atomic_get(&cb_state.count), TEST_BUFS_NUM,
			      "run %d: expected %d results, got %ld", run, TEST_BUFS_NUM,
			      atomic_get(&cb_state.count));
		zassert_equal(cb_state.last.seq, TEST_BUFS_NUM, "run %d: expected seq %d, got %u",
			      run, TEST_BUFS_NUM, cb_state.last.seq);
		zassert_equal(cb_state.last.type, MPIPE_AI_RESULTS_CLASSIFICATION,
			      "run %d: wrong results type", run);
		zassert_equal(cb_state.last.count, TEST_NUM_CLASSES,
			      "run %d: expected %d ranked classes, got %u", run, TEST_NUM_CLASSES,
			      cb_state.last.count);
		zassert_equal(cb_state.last.cls[0].class_id, expected_class,
			      "run %d: expected winning class %u, got %u", run, expected_class,
			      cb_state.last.cls[0].class_id);
		zassert_true(cb_state.last.cls[0].score > 0.9f,
			     "run %d: winning score not dominant", run);

		zassert_ok(mpipe_element_set_state((struct mpipe_element *)&fixture->pipeline,
						   MPIPE_STATE_READY),
			   "run %d failed to return to READY", run);
	}

	zassert_ok(zbus_chan_rm_obs(bus, &test_ai_pipeline_sub, K_FOREVER),
		   "Failed to remove observer from pipeline channel");
}
```

## src/test_chain.c
```c
/*
 * Copyright 2026 NXP
 *
 * SPDX-License-Identifier: Apache-2.0
 */

#include <zephyr/net_buf.h>
#include <zephyr/ztest.h>
#include <zephyr/zbus/zbus.h>

#include <zephyr/mpipe/mpipe.h>
#include <zephyr/mpipe/mpipe_buffer.h>
#include <zephyr/mpipe/mpipe_fake_src.h>
#include <zephyr/mpipe/mpipe_message.h>
#include <zephyr/mpipe/mpipe_sink.h>
#include <zephyr/mpipe/mpipe_transform.h>

/*
 * fake_src -> splitter -> counter -> sink
 *
 * The splitter turns every source buffer into a chain of CHAIN_LEN buffers,
 * as a parser does. The walk must hand them to the counter and the sink one
 * at a time, in order, each reaching the sink before the next is processed.
 */

ZBUS_MSG_SUBSCRIBER_DEFINE(test_chain_sub);

enum {
	PIPE_ID,
	SRC_ID,
	SPLITTER_ID,
	COUNTER_ID,
	SINK_ID,
};

#define SRC_BUFS  3
#define CHAIN_LEN 4
#define UNITS     (SRC_BUFS * CHAIN_LEN)

enum stage {
	STAGE_COUNTER,
	STAGE_SINK,
};

struct event {
	enum stage stage;
	uint64_t seq;
};

static struct event event_log[2 * UNITS];
static atomic_t event_count;
static atomic_t freed;

static void chain_destroy(struct net_buf *buf)
{
	atomic_inc(&freed);
	mpipe_buffer_destroy(buf);
}

NET_BUF_POOL_FIXED_DEFINE(chain_pool, 2 * CHAIN_LEN, 16, sizeof(struct mpipe_buffer_meta),
			  chain_destroy);

static void record(enum stage stage, const struct net_buf *buf)
{
	atomic_val_t i = atomic_inc(&event_count);

	if (i < ARRAY_SIZE(event_log)) {
		event_log[i].stage = stage;
		event_log[i].seq = mpipe_buffer_get_meta(buf)->pts;
	}
}

struct splitter {
	struct mpipe_transform transform;
	uint64_t seq;
};

struct counter {
	struct mpipe_transform transform;
	atomic_t calls;
	atomic_t chained;
	uint32_t fail_at;
};

struct chain_sink {
	struct mpipe_sink sink;
	atomic_t calls;
	atomic_t chained;
};

struct test_chain_fixture {
	struct mpipe pipeline;
	struct mpipe_fake_src fake_src;
	struct splitter splitter;
	struct counter counter;
	struct chain_sink sink;
};

/* One input in, CHAIN_LEN numbered buffers out as a chain */
static int splitter_process_fn(struct mpipe_pad *pad, struct net_buf *in_buf,
			       struct net_buf **out_buf)
{
	struct splitter *splitter = (struct splitter *)pad->object.container;

	net_buf_unref(in_buf);
	*out_buf = NULL;

	for (int i = 0; i < CHAIN_LEN; i++) {
		struct net_buf *buf = net_buf_alloc_len(&chain_pool, 16, K_NO_WAIT);
		struct mpipe_buffer_meta *meta;

		if (buf == NULL) {
			if (*out_buf != NULL) {
				net_buf_unref(*out_buf);
				*out_buf = NULL;
			}
			return -ENOBUFS;
		}

		meta = mpipe_buffer_get_meta(buf);
		meta->pool = NULL;
		meta->bytes_used = 16;
		meta->pts = splitter->seq++;
		meta->driver_buf = NULL;
		meta->priv = NULL;
		meta->parent = NULL;
		buf->len = 16;

		if (*out_buf == NULL) {
			*out_buf = buf;
		} else {
			net_buf_frag_add(*out_buf, buf);
		}
	}

	return 0;
}

static int counter_process_fn(struct mpipe_pad *pad, struct net_buf *in_buf,
			      struct net_buf **out_buf)
{
	struct counter *counter = (struct counter *)pad->object.container;
	atomic_val_t calls = atomic_inc(&counter->calls) + 1;

	if (in_buf->frags != NULL) {
		atomic_inc(&counter->chained);
	}

	record(STAGE_COUNTER, in_buf);

	if (counter->fail_at != 0U && calls == counter->fail_at) {
		net_buf_unref(in_buf);
		*out_buf = NULL;
		return -EIO;
	}

	*out_buf = in_buf;

	return 0;
}

static int sink_process_fn(struct mpipe_pad *pad, struct net_buf *in_buf, struct net_buf **out_buf)
{
	struct chain_sink *sink = (struct chain_sink *)pad->object.container;

	atomic_inc(&sink->calls);
	if (in_buf->frags != NULL) {
		atomic_inc(&sink->chained);
	}

	record(STAGE_SINK, in_buf);

	net_buf_unref(in_buf);
	*out_buf = NULL;

	return 0;
}

static void *chain_suite_setup(void)
{
	static struct test_chain_fixture fixture;

	return &fixture;
}

static void chain_before(void *f)
{
	struct test_chain_fixture *fix = f;
	struct zbus_channel *bus;

	memset(fix, 0, sizeof(*fix));
	memset(event_log, 0, sizeof(event_log));
	atomic_set(&event_count, 0);
	atomic_set(&freed, 0);

	zassert_ok(mpipe_pipeline_init(&fix->pipeline, PIPE_ID));
	zassert_ok(mpipe_fake_src_init(&fix->fake_src, SRC_ID));
	zassert_ok(mpipe_transform_init(&fix->splitter.transform, SPLITTER_ID));
	zassert_ok(mpipe_transform_init(&fix->counter.transform, COUNTER_ID));
	zassert_ok(mpipe_sink_init(&fix->sink.sink, SINK_ID));

	fix->splitter.transform.sink_pad.process_fn = splitter_process_fn;
	fix->counter.transform.sink_pad.process_fn = counter_process_fn;
	fix->sink.sink.sink_pad.process_fn = sink_process_fn;

	zassert_ok(mpipe_object_set_properties((struct mpipe_object *)&fix->fake_src,
					       MPIPE_PROP_SRC_NUM_BUFS, SRC_BUFS,
					       MPIPE_PROP_LIST_END));

	zassert_ok(mpipe_bin_add(
		(struct mpipe_bin *)&fix->pipeline, (struct mpipe_element *)&fix->fake_src,
		(struct mpipe_element *)&fix->splitter, (struct mpipe_element *)&fix->counter,
		(struct mpipe_element *)&fix->sink, NULL));
	zassert_ok(mpipe_element_link(
		(struct mpipe_element *)&fix->fake_src, (struct mpipe_element *)&fix->splitter,
		(struct mpipe_element *)&fix->counter, (struct mpipe_element *)&fix->sink, NULL));

	bus = mpipe_element_get_bus_chan((struct mpipe_element *)&fix->pipeline);
	zassert_ok(zbus_chan_add_obs(bus, &test_chain_sub, K_FOREVER));
}

static void chain_after(void *f)
{
	struct test_chain_fixture *fix = f;
	struct zbus_channel *bus =
		mpipe_element_get_bus_chan((struct mpipe_element *)&fix->pipeline);

	(void)zbus_chan_rm_obs(bus, &test_chain_sub, K_FOREVER);
}

ZTEST_SUITE(test_chain, NULL, chain_suite_setup, chain_before, chain_after, NULL);

/* Every fragment reaches the counter and the sink alone, in order, depth first */
ZTEST_F(test_chain, test_chain_is_pushed_one_fragment_at_a_time)
{
	const struct zbus_channel *chan;
	struct mpipe_message msg;

	zassert_ok(mpipe_element_set_state((struct mpipe_element *)&fixture->pipeline,
					   MPIPE_STATE_PLAYING));
	zassert_ok(zbus_sub_wait_msg(&test_chain_sub, &chan, &msg, K_SECONDS(5)));
	zassert_equal(msg.type, MPIPE_MESSAGE_EOS, "expected EOS, got %d", msg.type);
	zassert_ok(mpipe_element_set_state((struct mpipe_element *)&fixture->pipeline,
					   MPIPE_STATE_READY));

	zassert_equal(atomic_get(&fixture->counter.calls), UNITS, "counter saw %ld buffers",
		      atomic_get(&fixture->counter.calls));
	zassert_equal(atomic_get(&fixture->sink.calls), UNITS, "sink saw %ld buffers",
		      atomic_get(&fixture->sink.calls));
	zassert_equal(atomic_get(&fixture->counter.chained), 0, "the counter was handed a chain");
	zassert_equal(atomic_get(&fixture->sink.chained), 0, "the sink was handed a chain");
	zassert_equal(atomic_get(&freed), UNITS, "%ld chain buffers released", atomic_get(&freed));

	zassert_equal(atomic_get(&event_count), 2 * UNITS);
	for (uint32_t i = 0; i < UNITS; i++) {
		zassert_equal(event_log[2 * i].stage, STAGE_COUNTER, "event %u", 2 * i);
		zassert_equal(event_log[2 * i].seq, i, "event %u: buffer %llu", 2 * i,
			      event_log[2 * i].seq);
		zassert_equal(event_log[2 * i + 1].stage, STAGE_SINK, "event %u", 2 * i + 1);
		zassert_equal(event_log[2 * i + 1].seq, i, "event %u: buffer %llu", 2 * i + 1,
			      event_log[2 * i + 1].seq);
	}
}

/* A failure on one fragment releases the ones not pushed yet */
ZTEST_F(test_chain, test_failure_releases_the_rest_of_the_chain)
{
	const struct zbus_channel *chan;
	struct mpipe_message msg;

	fixture->counter.fail_at = 2;

	zassert_ok(mpipe_element_set_state((struct mpipe_element *)&fixture->pipeline,
					   MPIPE_STATE_PLAYING));
	zassert_ok(zbus_sub_wait_msg(&test_chain_sub, &chan, &msg, K_SECONDS(5)));
	zassert_equal(msg.type, MPIPE_MESSAGE_ERROR, "expected an error, got %d", msg.type);
	zassert_equal(msg.domain, MPIPE_ERROR_FLOW);
	zassert_equal(msg.code, -EIO);
	zassert_equal(msg.origin, (struct mpipe_element *)&fixture->counter);

	/* READY joins the streaming thread, so the walk has released its leftovers */
	zassert_ok(mpipe_element_set_state((struct mpipe_element *)&fixture->pipeline,
					   MPIPE_STATE_READY));

	zassert_equal(atomic_get(&fixture->counter.calls), 2);
	zassert_equal(atomic_get(&fixture->sink.calls), 1, "the sink saw %ld buffers",
		      atomic_get(&fixture->sink.calls));
	zassert_equal(atomic_get(&freed), CHAIN_LEN, "%ld of %d chain buffers released",
		      atomic_get(&freed), CHAIN_LEN);
}
```

## src/test_mock_pipeline.c
```c
/*
 * Copyright 2026 NXP
 *
 * SPDX-License-Identifier: Apache-2.0
 */

#include <zephyr/ztest.h>
#include <zephyr/zbus/zbus.h>

#include <zephyr/mpipe/mpipe.h>
#include <zephyr/mpipe/mpipe_fake_src.h>
#include <zephyr/mpipe/mpipe_message.h>
#include <zephyr/mpipe/mpipe_sink.h>
#include <zephyr/mpipe/mpipe_transform.h>

ZBUS_MSG_SUBSCRIBER_DEFINE(test_pipeline_sub);

/* Element IDs (values are arbitrary; only uniqueness within the pipeline matters) */
enum {
	PIPE_ID,
	SRC_ID,
	TRANSFORM_ID,
	SINK_ID,
};

/* Number of buffers the source shall produce before EOS */
#define TEST_BUFS_NUM 10

struct test_mock_pipeline_fixture {
	struct mpipe pipeline;
	struct mpipe_fake_src fake_src;
	struct mpipe_transform transform;
	struct mpipe_sink sink;
};

static void *pipeline_suite_setup(void)
{
	static struct test_mock_pipeline_fixture fixture;

	return &fixture;
}

static void pipeline_before(void *f)
{
	struct test_mock_pipeline_fixture *fix = f;

	memset(fix, 0, sizeof(*fix));

	zassert_ok(mpipe_pipeline_init(&fix->pipeline, PIPE_ID));
	zassert_ok(mpipe_fake_src_init(&fix->fake_src, SRC_ID));
	zassert_ok(mpipe_transform_init(&fix->transform, TRANSFORM_ID));
	zassert_ok(mpipe_sink_init(&fix->sink, SINK_ID));

	/* Set number of buffers to produce before EOS */
	zassert_ok(mpipe_object_set_properties((struct mpipe_object *)&fix->fake_src,
					       MPIPE_PROP_SRC_NUM_BUFS,
					       MPIPE_PROP_INT(TEST_BUFS_NUM), MPIPE_PROP_LIST_END),
		   "Failed to set fake_src MPIPE_PROP_SRC_NUM_BUFS");
}

static void pipeline_after(void *f)
{
	struct test_mock_pipeline_fixture *fix = f;
	struct zbus_channel *bus =
		mpipe_element_get_bus_chan((struct mpipe_element *)&fix->pipeline);

	/* Also runs when the test failed before detaching its own observer. */
	(void)zbus_chan_rm_obs(bus, &test_pipeline_sub, K_FOREVER);
}

ZTEST_SUITE(test_mock_pipeline, NULL, pipeline_suite_setup, pipeline_before, pipeline_after, NULL);

ZTEST_F(test_mock_pipeline, test_pipeline_fake_src_transform_sink)
{
	const struct zbus_channel *chan;
	struct zbus_channel *bus;
	struct mpipe_message msg;

	/* Add all elements to the pipeline */
	zassert_ok(mpipe_bin_add((struct mpipe_bin *)&fixture->pipeline,
				 (struct mpipe_element *)&fixture->fake_src,
				 (struct mpipe_element *)&fixture->transform,
				 (struct mpipe_element *)&fixture->sink, NULL),
		   "Failed to add elements");

	/* Link: fake_src -> transform -> sink */
	zassert_ok(mpipe_element_link((struct mpipe_element *)&fixture->fake_src,
				      (struct mpipe_element *)&fixture->transform,
				      (struct mpipe_element *)&fixture->sink, NULL),
		   "Failed to link elements");

	/* Attach the subscriber to the pipeline bin's channel at runtime. */
	bus = mpipe_element_get_bus_chan((struct mpipe_element *)&fixture->pipeline);
	zassert_ok(zbus_chan_add_obs(bus, &test_pipeline_sub, K_FOREVER),
		   "Failed to add observer to pipeline channel");

	/* Replay: state left by one run must not leak into the next */
	for (int run = 0; run < 3; run++) {
		zassert_ok(mpipe_element_set_state((struct mpipe_element *)&fixture->pipeline,
						   MPIPE_STATE_PLAYING),
			   "run %d failed to start PLAYING", run);

		/* Wait for EOS posted by the sink */
		zassert_ok(zbus_sub_wait_msg(&test_pipeline_sub, &chan, &msg, K_SECONDS(2)),
			   "run %d timed out waiting for a pipeline message", run);
		zassert_equal(msg.type, MPIPE_MESSAGE_EOS, "run %d: expected EOS, got %d", run,
			      msg.type);

		/* Exactly one EOS per run: a second would mean the aggregation leaked */
		zassert_equal(zbus_sub_wait_msg(&test_pipeline_sub, &chan, &msg, K_MSEC(50)),
			      -ENOMSG, "run %d produced more than one message", run);

		/* Bring pipeline back to READY and join the thread */
		zassert_ok(mpipe_element_set_state((struct mpipe_element *)&fixture->pipeline,
						   MPIPE_STATE_READY),
			   "run %d failed to return to READY", run);
	}

	/* Detach the runtime observer */
	zassert_ok(zbus_chan_rm_obs(bus, &test_pipeline_sub, K_FOREVER),
		   "Failed to remove observer from pipeline channel");
}
```
